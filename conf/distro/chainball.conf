## conf/distro/chainball.conf
```bitbake
require conf/distro/poky.conf
DISTRO = "chainball"
DISTRO_NAME = "Chainbot default distribution. "
DISTRO_VERSION = "1.0"
DISTRO_FEATURES_append += " alsa systemd wifi"
DISTRO_EXTRA_RDEPENDS += "\
  initscripts \
  systemd \
  systemd-analyze \
  "
# Switch init-system to systemd
VIRTUAL-RUNTIME_init_manager = "systemd"
DISTRO_FEATURES_BACKFILL_CONSIDERED = "sysvinit"
VIRTUAL-RUNTIME_initscripts = ""
VIRTUAL-RUNTIME_base-utils = ""
VIRTUAL-RUNTIME_login_manager = "shadow"
PREFERRED_VERSION_linux-yocto_qemuarm = "4.19%"
PACKAGE_FEED_URIS = "http://bmorais39.duckdns.org:50000/"

# sign RPMs
INHERIT += "sign_rpm"
RPM_GPG_NAME = "Bruno Morais (Chainbot packages)"
RPM_GPG_PASSPHRASE ?= ""

INHERIT += "sign_package_feed"
PACKAGE_FEED_GPG_NAME = "Bruno Morais (Chainbot packages)"
PACKAGE_FEED_GPG_PASSPHRASE_FILE ?= ""
```

## conf/layer.conf
```bitbake
# We have a conf and classes directory, add to BBPATH
BBPATH .= ":${LAYERDIR}"

# We have recipes-* directories, add to BBFILES
BBFILES += "${LAYERDIR}/recipes-*/*/*.bb \
	${LAYERDIR}/recipes-*/*/*.bbappend"

BBFILE_COLLECTIONS += "chainball"
BBFILE_PATTERN_chainball = "^${LAYERDIR}/"
BBFILE_PRIORITY_chainball = "5"
LAYERSERIES_COMPAT_chainball = "thud warrior"

LAYERDEPENDS_chainball = "core meta-python openembedded-layer"
DEFAULT_TIMEZONE ?= "America/New_York"

# no serial console
SERIAL_CONSOLES = ""
MACHINE_FEATURES_remove = "screen touchscreen bluetooth"
```
